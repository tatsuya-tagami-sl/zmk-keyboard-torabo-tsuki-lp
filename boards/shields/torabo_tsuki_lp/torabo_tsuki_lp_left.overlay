#include "torabo_tsuki_lp.dtsi"
#include <input/processors.dtsi>
#include <dt-bindings/zmk/input_transform.h>

&pointing_listener {
    input-processors = <&zip_temp_layer_exclusive_rh_clicks 1 1500>, <&zip_xy_transform (INPUT_TRANSFORM_X_INVERT | INPUT_TRANSFORM_Y_INVERT)>;

    layer_4_scroll {
        layers = <4>;
        input-processors = <&zip_xy_to_scroll_mapper>;
        process-next;
    };
};
